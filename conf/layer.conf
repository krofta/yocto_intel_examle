## conf/layer.conf
```bitbake
# We have a conf and classes directory, add to BBPATH
BBPATH .= ":${LAYERDIR}"

# We have recipes-* directories, add to BBFILES
BBFILES += "${LAYERDIR}/recipes-*/*/*.bb \
            ${LAYERDIR}/recipes-*/*/*.bbappend"

BBFILE_COLLECTIONS += "own-layer"
BBFILE_PATTERN_own-layer = "^${LAYERDIR}/"
BBFILE_PRIORITY_own-layer = "6"

LAYERDEPENDS_own-layer = "core"
LAYERSERIES_COMPAT_own-layer = "dunfell"
```
